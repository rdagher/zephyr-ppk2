## Kconfig
```kconfig
# SPDX-License-Identifier: Apache-2.0 OR MIT

config PPK2_TRACE
	bool "PPK2 trace markers"
	depends on GPIO
	help
	  GPIO markers (ppk2_trace.h) wired to the digital inputs D0..D7
	  of a PPK2, to measure the current drawn while marked code runs.
	  The pins come from the zephyr,user devicetree properties
	  ppk2-d0-gpios to ppk2-d7-gpios. When disabled, the markers
	  compile to nothing.

config PPK2_TRACE_RADIO
	bool "Radio channel, high from the radio's READY to DISABLED"
	depends on PPK2_TRACE && MPSL && (SOC_COMPATIBLE_NRF54LX || MPSL_PIN_DEBUG)
	select NRFX_GPIOTE if !MPSL_PIN_DEBUG
	select NRFX_GPPI if !MPSL_PIN_DEBUG
	help
	  The hardware raises the channel at the radio's READY event and
	  drops it at DISABLED. No code runs for it, and the ramp-up before
	  READY is not inside the marked region. The channel is claimed
	  under the name "radio".

	  With CONFIG_MPSL_PIN_DEBUG, the nRF Connect SDK drives the pin
	  and the module only names the channel. The pin wired to the
	  channel must be the one of
	  CONFIG_MPSL_PIN_DEBUG_RADIO_READY_AND_DISABLED_PIN. Without that
	  option, the module routes the two events itself, on the nRF54L
	  series only.

config PPK2_TRACE_RADIO_CHANNEL
	int "Channel of the radio"
	depends on PPK2_TRACE_RADIO
	range 0 7
	default 0
	help
	  The channel 0..7, and so the digital input D0..D7, that the
	  radio drives. Its pin must be wired in the devicetree.
```

## samples/profiling/sample.yaml
```yaml
sample:
  name: PPK2 phase profiling
  description: A low-power application cycle with a PPK2 marker on each phase
tests:
  sample.ppk2.profiling:
    platform_allow:
      - nrf52840dk/nrf52840
      - nrf54lm20dk/nrf54lm20b/cpuapp
    tags: ppk2 power
    build_only: true
```
